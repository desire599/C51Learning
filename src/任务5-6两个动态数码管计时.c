//程序：任务5-6两个动态数码管计时
//功能：00～99的简易秒表设计，两个动态数码管共阴极接法，定时器采用中断方式
#include "reg51.h" //包含头文件reg51.h，定义了51单片机的专用寄存器
//全局变量定义
unsigned char count = 0; //对50ms定时时间进行计数
unsigned char miao = 0;  //秒计数器

//函数名：timer_1()
//函数功能：定时器T1中断函数，假设T1在工作方式1下每50ms产生中断，执行该中断函数
//形式参数：无
//返回值：无
void timer_1() interrupt 3 //（5）编写中断服务程序，T1的中断类型号为3
{
    count++;                    //50ms计数器加1
    TH1 = (65536 - 5000) / 256; //重新设置T1计数初值高8位
    TL1 = (65536 - 5000) % 256; //重新设置T1计数初值低8位
    if (count == 20)            //1s时间到
    {
        count = 0; //50ms计数器清0
        miao++;    //秒计数器加1
        if (miao == 100)
            miao = 0; //miao计数到100，则从0开始计数
    }
}

//函数名：disp(unsigned char i)
//函数功能：将i的值显示在两个动态连接的数码管上，采用共阴极接法，方便使用“P口的低电平有效”原则
//形式参数：i，取值范围0～99
//返回值：无

void disp(unsigned char i)
{
    unsigned char j;
    unsigned char code led[] = {0x3f, 0x06, 0x5b, 0x4f, 0x66, 0x6d, 0x7d, 0x07, 0x7f, 0x6f};
    //定义0～9显示码，共阴极数码管
    P2 = 0xff;        //关闭6个数码管
    P1 = led[i / 10]; //此时的i值为miao的值，显示秒miao十位，除法后的商放在右起第2个数码管
    P2 = 0xfd;        //只打开第2个数码管,P2.0 P2=1111 1101=0xfd
    for (j = 0; j < 100; j++)
        ; //空运算100次，延时约1ms
    P2 = 0xff;
    P1 = led[i % 10]; //显示秒miao个位，取余数放在右起第1个数码管
    P2 = 0xfe;        //只打开第1个数码管,P2.1 P2=1111 1110=0xfe
    for (j = 0; j < 100; j++)
        ; //空运算100次，延时约1ms
}

void main() //主函数
{
    TMOD = 0x10;                 //（1）设置T1为工作方式1
    TH1 = (65536 - 50000) / 256; //（2）设置T1计数初值高8位，定时时间50ms
    TL1 = (65536 - 50000) % 256; //（2）设置T1计数初值低8位
    EA = 1;                      //（3）开放总中断允许
    ET1 = 1;                     //（3）开放T1中断允许
    TR1 = 1;                     //（4）启动T1开始计数
    while (1)
    {
        disp(miao); //把miao的值写入到disp函数的形参i中，选择对应一维数组的数，从而显示秒计数器值
    }
}
