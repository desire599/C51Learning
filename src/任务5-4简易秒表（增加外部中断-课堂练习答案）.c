//功能：00～99的简易秒表设计，两个静态数码管，定时器采用中断方式
#include "reg51.h" //包含头文件reg51.h，定义了51单片机的专用寄存器

//全局变量定义
unsigned char count = 0; //对50ms定时时间进行计数
unsigned char miao = 0;	 //秒计数器

//函数名：timer_1()
//函数功能：定时器T1中断函数，假设T1在工作方式1下每50ms产生中断，则在定时器启动后系统自动每隔50ms进入执行这个中断函数

void timer_1() interrupt 3 //（5）编写中断服务程序，T1的中断类型号为3
{
	count++;					 //50ms计数器加1
	TH1 = (65536 - 50000) / 256; //重新设置T1计数初值高8位
	TL1 = (65536 - 50000) % 256; //重新设置T1计数初值低8位
	if (count == 20)			 //1s时间到
	{
		count = 0; //50ms计数器清0
		miao++;	   //秒计数器加1
		if (miao == 100)
			miao = 0; //miao计数到100，则从0开始计数
	}
}

//函数名：disp(unsigned char i)
//函数功能：将i的值显示在两个静态连接的数码管上
//形式参数：i，取值范围0～99
void disp(unsigned char i)
{
	unsigned char led[] = {0xc0, 0xf9, 0xa4, 0xb0, 0x99, 0x92, 0x82, 0xf8, 0x80, 0x90};
	//定义0～9显示码，共阳极数码管
	P1 = led[i / 10]; //显示i高位，商放在左边第一个LED
	P2 = led[i % 10]; //显示i低位，取余数放在第二个LED
}

void int0() interrupt 0 //外部中断0，即K1，不需要做sbit定义引脚。功能：启动/暂停计时
{
	TR1 = ~TR1; //（6）启动T1开始计时，再次进入则停止计时
}

void int2() interrupt 2 //外部中断1，即K2，功能：计时清零
{
	miao = 0;  //对计时器的显示数值清零
	count = 0; //对50ms的统计次数也清零
	/*由于可能在统计1秒钟的过程中执行了清零，为了保证下一次开始计时时能够计满1秒，需要重新对定时器放初始值*/
	TH1 = (65536 - 50000) / 256; //（2）设置T1计数初值高8位，定时时间50ms
	TL1 = (65536 - 50000) % 256; //（2）设置T1计数初值低8位
}

void main() //主函数
{
	TMOD = 0x10;				 //（1）设置T1为工作方式1
	TH1 = (65536 - 50000) / 256; //（2）设置T1计数初值高8位，定时时间50ms
	TL1 = (65536 - 50000) % 256; //（2）设置T1计数初值低8位
	EA = 1;						 //（3）开放总中断允许
	ET1 = 1;					 //（3）开放定时器T1中断允许
	EX0 = 1;					 //（4）开放外部中断0允许
	EX1 = 1;					 //开放外部中断1允许
	IT0 = 1;					 //（5）启动外部中断0，以下降沿方式触发中断
	IT1 = 1;					 //启动外部中断1，以下降沿方式触发中断

	while (1)
	{
		disp(miao); //显示秒计数器值
	}
}

/*第2种方法：设置标志位，判断按键按进的次数
bit b = 0;				 //外部位变量b，暂停/继续标志位，b=0暂停，b=1继续
void int_0() interrupt 0 //外部中断0的中断函数，中断类型号为0
{
	if (b == 0)
	{
		TR1 = 0;
		b = 1;
	} //暂停计数
	else
	{
		b = 0;
		TR1 = 1;
	} //继续计数
}
*/