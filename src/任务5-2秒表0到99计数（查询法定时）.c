//程序：ex5_1.c
//功能：00～99的简易秒表设计，两个静态数码管，定时器采用查询方式
#include "reg51.h"  //包含头文件reg51.h，定义了51单片机的专用寄存器

//函数名：timer_1()
//函数功能：定时器T1在工作方式1下实现计时
//形式参数：无 
//返回值：无
void timer_1() 
{ 
	unsigned char i;
  	TMOD=0x10;         	   	 //（1）设置T1为工作方式1
	for(i=0;i<20;i++)//因为完成1次定时，耗时50ms，所以执行20次就为1s（50ms*20=1000ms）
	{
		TH1=(65536-50000)/256;   //（2）重新设置T1计数初值高8位
		TL1=(65536-50000)%256;   //（2）重新设置T1计数初值低8位
		TR1=1;                   //（3）启动T1
		while(!TF1);             //（4）查询T1的溢出标志TF1，当计满数时，TF1=1
		TF1=0;                   //（5）对T1的溢出标志TF1清零，以便下一次执行		
	}	
}

void main()					//主函数
{
	unsigned char i;//循环计数变量i
	unsigned char disp[]={0xc0,0xf9,0xa4,0xb0,0x99,0x92,0x82,0xf8,0x80,0x90};
//定义0～9显示码，共阳极数码管
   while(1)         //无限循环
	 {
		for(i=0;i<100;i++)
		{
			 P1=disp[i/10];//i/10得到是十位
			 P2=disp[i%10];//i%10得到是个位
			 timer_1();      //调用定时器T1计时1s的函数
     	}
	 }
}
