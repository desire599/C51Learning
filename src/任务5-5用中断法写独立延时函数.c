//程序：ex5_1.c
//功能：00～99的简易秒表设计，两个静态数码管，定时器采用中断方式
#include "reg51.h" //包含头文件reg51.h，定义了51单片机的专用寄存器
sbit LED = P1 ^ 0;
unsigned int counter = 0;
bit tim
//函数名：timer_1()
//函数功能：定时器T1中断函数，假设T1在工作方式1下每50ms产生中断，执行该中断函数

void timer1_ms() interrupt 3 //（5）编写中断服务程序，T1的中断类型号为3
{
    counter++;                   //50ms计数器加1
    TH1 = (65536 - 50000) / 256; //重新设置T1计数初值高8位，这样定时器又可以开始重新计时50ms
    TL1 = (65536 - 50000) % 256; //重新设置T1计数初值低8位
    /*由于采用中断法定时时是每隔50ms自动进入这个函数，不能像查询法那样写好时间，
  因此只有通过统计进入中断函数的次数count，才知道定时的时间*/
    if (counter == 20) //50ms*20,即1s的时间到了
    {
        counter = 0; //对50ms计数器i清0
    }
}

void main() //主函数
{
    TMOD = 0x10;                 //（1）设置T1为工作方式1
    TH1 = (65536 - 50000) / 256; //（2）设置T1计数初值高8位，定时时间50ms
    TL1 = (65536 - 50000) % 256; //（2）设置T1计数初值低8位
    EA = 1;                      //（3）开放总中断允许
    ET1 = 1;                     //（3）开放定时器T1中断允许
    TR1 = 1;                     //（4）启动T1开始计数
    while (1)
    {
        if (counter == 20)
        {
            LED = ~LED;
        }
    }
}
